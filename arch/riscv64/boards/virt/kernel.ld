/* kernel.ld -- リンカへの配置指示書 (riscv64)
 *
 * コンパイル直後の部品 (オブジェクトファイル) は、命令やデータの
 * かたまり (セクション) でしかなく、まだ住所が決まっていない。
 * それらを 1 つの実行ファイルに組み立てて住所を割り振るのが
 * リンカの仕事で、その「どこに何を置くか」の指示書がこのファイル。
 * build.sh の中で gcc -T kernel.ld として渡される。
 *
 * 普通の Linux プログラムならリンカのデフォルト配置でよいが、
 * カーネルは置き場所をファームウェア (OpenSBI) と約束している
 * ので、自前で指定する必要がある。
 *
 * 注: リンカスクリプトのコメントは C と同じ形だけが使える。
 */

/* 入口は _start だという宣言。ELF ヘッダに記録され、ローダが
 * 「ここから実行」と分かるようになる。 */
ENTRY(_start)

SECTIONS {
  /* 「現在位置」のカウンタをこの住所にセットし、ここから
   * 順に詰めていく。QEMU virt の RAM は 0x80000000 始まりで、
   * 最初の 2MB を OpenSBI が使うため、そのすぐ後ろに置く。 */
  . = 0x80200000;

  /* 全部品の .text (命令) を集める。先頭に置くことが大事で、
   * OpenSBI が 0x80200000 にジャンプしてきたとき、最初に
   * _start の命令が無ければならない。ビルド ID のような別
   * セクションが先頭に割り込むと壊れるので注意。 */
  .text : { *(.text) }

  /* 文字列などの読み取り専用データを命令の後ろに。 */
  .rodata : { *(.rodata) }

  /* 初期値つきの書き換え可能データ (C の初期値つき変数など)。 */
  .data : { *(.data) *(.sdata) }

  /* 初期値ゼロの予約地 (スタック領域など)。ファイルの中に
   * 実体は持たず、住所の範囲だけを確保する。範囲を
   * __bss_start / __bss_end という名前で外に伝え、start.S が
   * 起動時にその範囲を実際にゼロで埋める。 */
  .bss : {
    __bss_start = .;
    *(.bss) *(.sbss) *(COMMON)
    __bss_end = .;
  }

  /* カーネルの BSS がページプール (board.h の
   * BOARD_PAGE_POOL_BASE = 0x82200000) に食い込んでは
   * いけない。食い込むと、プールから配ったページと
   * カーネルの静的データが同じ物理メモリを指し、大きな
   * プログラムから静かに壊れる (2026-11-07 に ramdisk の
   * 写し 16MiB で実際に踏んだ)。 */
  ASSERT(__bss_end <= 0x82200000,
         "kernel BSS overflows into the page pool (see boards/virt/board.h)")

  /* 結果の住所 (ビルド済み kernel の実数):
   *   0x80200000  _start / .text 先頭
   *   0x80200034  kmain (C の入口、.text の中)
   *   0x80200210  __bss_start = stack (.bss の始まり)
   *   0x80201210  stack_top = __bss_end (.bss はスタックの 4KB)
   * start.S の %pcrel_hi / %pcrel_lo の計算は、リンカが
   * ここで決めた配置を元に答えを出している。 */
}
