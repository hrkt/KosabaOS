/* kernel.ld -- リンカへの配置指示書 (riscv64)
 *
 * コンパイル直後の部品 (オブジェクトファイル) は、命令やデータの
 * かたまり (セクション) でしかなく、まだ住所が決まっていない。
 * それらを 1 つの実行ファイルに組み立てて住所を割り振るのが
 * リンカの仕事で、その「どこに何を置くか」の指示書がこのファイル。
 * build.sh の中で gcc -T kernel.ld として渡される。
 *
 * 普通の Linux プログラムならリンカのデフォルト配置でよいが、
 * カーネルは置き場所をファームウェア (OpenSBI) と約束している
 * ので、自前で指定する必要がある。
 *
 * 注: リンカスクリプトのコメントは C と同じ形だけが使える。
 */

/* 入口は _start だという宣言。ELF ヘッダに記録され、ローダが
 * 「ここから実行」と分かるようになる。 */
ENTRY(_start)

SECTIONS {
  /* 「現在位置」のカウンタをこの住所にセットし、ここから
   * 順に詰めていく。QEMU virt の RAM は 0x80000000 始まりで、
   * 最初の 2MB を OpenSBI が使うため、そのすぐ後ろに置く。 */
  . = 0x80200000;

  /* 全部品の .text (命令) を集める。先頭に置くことが大事で、
   * OpenSBI が 0x80200000 にジャンプしてきたとき、最初に
   * _start の命令が無ければならない。ビルド ID のような別
   * セクションが先頭に割り込むと壊れるので注意。 */
  .text : { *(.text) }

  /* 文字列 msg などの読み取り専用データを命令の後ろに。 */
  .rodata : { *(.rodata) }

  /* 初期値ゼロの予約地 (スタック領域など)。ファイルの中に
   * 実体は持たず、住所の範囲だけを確保する。 */
  .bss : { *(.bss) }

  /* 結果の住所 (ビルド済み kernel の実数):
   *   0x80200000  _start / .text
   *   0x80200026  msg / .rodata
   *   0x80200050  stack / .bss (ここから 4KB)
   *   0x80201050  stack_top
   * start.S の %pcrel_hi / %pcrel_lo の計算は、リンカが
   * ここで決めた配置を元に答えを出している。 */
}
